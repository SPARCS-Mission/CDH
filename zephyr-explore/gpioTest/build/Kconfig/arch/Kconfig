## zephyr-explore/gpioTest/build/Kconfig/arch/Kconfig
```kconfig
# Load Zephyr Arch Kconfig descriptions.
osource "/home/isss/zephyrproject/zephyr/arch/x86/Kconfig"
osource "/home/isss/zephyrproject/zephyr/arch/xtensa/Kconfig"
osource "/home/isss/zephyrproject/zephyr/arch/sparc/Kconfig"
osource "/home/isss/zephyrproject/zephyr/arch/riscv/Kconfig"
osource "/home/isss/zephyrproject/zephyr/arch/posix/Kconfig"
osource "/home/isss/zephyrproject/zephyr/arch/nios2/Kconfig"
osource "/home/isss/zephyrproject/zephyr/arch/mips/Kconfig"
osource "/home/isss/zephyrproject/zephyr/arch/arm64/Kconfig"
osource "/home/isss/zephyrproject/zephyr/arch/arm/Kconfig"
osource "/home/isss/zephyrproject/zephyr/arch/arc/Kconfig"
```

## zephyr-explore/gpioTest/build/Kconfig/boards/Kconfig
```kconfig
# Load Zephyr board Kconfig descriptions.
osource "/home/isss/zephyrproject/zephyr/boards/st/nucleo_h723zg/Kconfig"
```

## zephyr-explore/gpioTest/build/Kconfig/boards/Kconfig.defconfig
```kconfig
# Load Zephyr board defconfig descriptions.
osource "/home/isss/zephyrproject/zephyr/boards/st/nucleo_h723zg/Kconfig.defconfig"
```

## zephyr-explore/gpioTest/build/Kconfig/boards/Kconfig.nucleo_h723zg
```kconfig
# Load board Kconfig descriptions.
osource "/home/isss/zephyrproject/zephyr/boards/st/nucleo_h723zg/Kconfig.nucleo_h723zg"
```

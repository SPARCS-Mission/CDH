&clk_hsi{
    status = "okay";
};

&pll{
    clocks = < &clk_hsi >;
    mul-n = < 0x1f >;
};

&rcc{
    clocks = < &hsi >;
    clock-frequency = < 0x3d09000 >;
    d1cpre = < 0x1 >;
    hpre = < 0x2 >;
    d1ppre = < 0x1 >;
    d2ppre1 = < 0x1 >;
    d2ppre2 = < 0x1 >;
    d3ppre = < 0x1 >;
};